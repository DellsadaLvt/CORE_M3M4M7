;define RCC and GPIO address
RCC_BASE			EQU		0x40021000
RCC_APB2ENR			EQU     0x40021018
GPIOC_BASE			EQU  	0x40011000
GPIOC_CRH			EQU		0x40011004	
GPIOC_BSRR			EQU     0x40011010
TIM_DELAY  			EQU		100000000



	AREA GPIO, CODE, READONLY
	ENTRY
	EXPORT __main
		
		
__main
	; enable CLK port C in RCC register
	LDR R0,=RCC_APB2ENR
	LDR R1,[R0]
	ORR R1,R1,#0x10
	STR R1,[R0]
	; set mode pin PC13
	LDR R0,=GPIOC_CRH
	LDR R1,[R0]
	ORR R1,R1,#0x00300000
	AND R1,R1,#0xFF3FFFFF
	STR R1,[R0]
	B _LOOP
	
_LOOP
	BL _TURN_ON_LED
	LDR R2,=TIM_DELAY
	BL _DELAY
	BL _TURN_OFF_LED
	LDR R2,=TIM_DELAY
	BL _DELAY
	B _LOOP
	
_TURN_ON_LED
	; Turn on LED
	LDR R0,=GPIOC_BSRR
	LDR R1,[R0]
	ORR R1,R1,#0x00002000
	STR R1,[R0]
	MOV PC,R14
	
	
_TURN_OFF_LED
	LDR R0,=GPIOC_BSRR
	LDR R1,[R0]
	ORR R1,R1,#0x20000000
	STR R1,[R0]
	MOV PC,R14
	
_DELAY
	SUBS R2,#1
	BNE _DELAY
	MOV PC,R14


_STOP B _STOP
	END


